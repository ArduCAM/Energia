# crc32 register map
Vendor: Texas Instruments
Peripheral module from a debugger description file (folder MSP432).
Registers are 16-bit, read-write, no defined reset value unless marked. A register's access mark holds for its fields unless they carry their own. Offsets are as the file gives them; lines under a group give offsets from that group; [hi:lo] are bit positions; {n}, {i} and the like mark numbered series; 'fields as' and 'values as' point back to an identical list; <NAME> marks a mode.

## CRC32
0x00 CRC32DI — Data Input for CRC32 Signature Computation
  [15:0] DI — Data input for CRC32 Computation
0x04 CRC32DIRB — Data In Reverse for CRC32 Computation
  [15:0] DIRB — CRC32 data in bit reversed
0x08 CRC32INIRES_LO — CRC32 Initialization and Result, lower 16 bits
  [15:0] CRC32INIRES_LO — CRC32 initialization and result, lower 16 bits
0x0A CRC32INIRES_HI — CRC32 Initialization and Result, upper 16 bits
  [15:0] CRC32INIRES_HI — CRC32 initialization and result, upper 16 bits
0x0C CRC32RESR_LO — CRC32 Result Reverse, lower 16 bits
  [15:0] CRC32RESR_LO — CRC32 reverse result, lower 16 bits
0x0E CRC32RESR_HI — CRC32 Result Reverse, Upper 16 bits
  [15:0] CRC32RESR_HI — CRC32 reverse result, upper 16 bits
0x10 CRC16DI — Data Input for CRC16 computation
  [15:0] CRC16DI — CRC16 data in
0x14 CRC16DIRB — CRC16 Data In Reverse
  [15:0] CRC16DIRB — CRC16 data in reverse byte
0x18 CRC16INIRES — CRC16 Initialization and Result register
  [15:0] CRC16INIRES — CRC16 initialization and result
0x1E CRC16RESR — CRC16 Result Reverse
  [15:0] CRC16RESR — CRC16 reverse result
