# C2000_SCI_Type0_Registers register map
Vendor: Texas Instruments
Peripheral module from a debugger description file (folder C2000).
Address unit: 16 bits
Registers are 16-bit, access not given, no defined reset value unless marked. A register's access mark holds for its fields unless they carry their own. Offsets are as the file gives them; lines under a group give offsets from that group; [hi:lo] are bit positions; {n}, {i} and the like mark numbered series; 'fields as' and 'values as' point back to an identical list; <NAME> marks a mode.

## SCI — Serial Communication Interface Registers
0x00 SCICCR — SCI Communications Control Register
0x01 SCICTL1 — SCI Control Register 1
0x02 SCIHBAUD — SCI Baud Register, High Bits
0x03 SCILBAUD — SCI Baud Register, Low Bits
0x04 SCICTL2 — SCI Control Register 2
0x05 SCIRXST — SCI Receive Status Register
0x06 SCIRXEMU — SCI Receive Emulation Data Buffer Register
0x07 SCIRXBUF — SCI Receive Data Buffer Register
0x09 SCITXBUF — SCI Transmit Data Buffer Register
0x0A SCIFFTX — SCI FIFO Transmit Register
0x0B SCIFFRX — SCI FIFO Receive Register
0x0C SCIFFCT — SCI FIFO Control Register
0x0F SCIPRI — SCI Priority Control Register
