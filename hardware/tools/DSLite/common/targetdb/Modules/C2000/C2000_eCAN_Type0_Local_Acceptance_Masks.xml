# C2000_eCAN_Type0_Local_Acceptance_Masks register map
Vendor: Texas Instruments
Peripheral module from a debugger description file (folder C2000).
Address unit: 16 bits
Registers are 32-bit, access not given, no defined reset value unless marked. A register's access mark holds for its fields unless they carry their own. Offsets are as the file gives them; lines under a group give offsets from that group; [hi:lo] are bit positions; {n}, {i} and the like mark numbered series; 'fields as' and 'values as' point back to an identical list; <NAME> marks a mode.

## ECAN_LAM — eCAN Local Acceptance Masks
{0x0+2i} MBX{i}_LAM (i=0..31) — eCAN Mailbox {i} Local Acceptance Mask
