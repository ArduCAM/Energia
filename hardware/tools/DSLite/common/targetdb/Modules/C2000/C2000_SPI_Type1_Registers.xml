# C2000_SPI_Type1_Registers register map
Vendor: Texas Instruments
Peripheral module from a debugger description file (folder C2000).
Address unit: 16 bits
Registers are 16-bit, access not given, no defined reset value unless marked. A register's access mark holds for its fields unless they carry their own. Offsets are as the file gives them; lines under a group give offsets from that group; [hi:lo] are bit positions; {n}, {i} and the like mark numbered series; 'fields as' and 'values as' point back to an identical list; <NAME> marks a mode.

## SPI — Serial Peripheral Interface Registers
0x00 SPICCR — SPI Configuration Control Register
0x01 SPICTL — SPI Operation Control Register
0x02 SPISTS — SPI Status Register
0x04 SPIBRR — SPI Baud Rate Register
0x06 SPIRXEMU — SPI Receive Emulation Buffer Register
0x07 SPIRXBUF — SPI Serial Input Buffer Register
0x08 SPITXBUF — SPI Serial Output Buffer Register
0x09 SPIDAT — SPI Serial Data Register
0x0A SPIFFTX — SPI FIFO Transmit Register
0x0B SPIFFRX — SPI FIFO Receive Register
0x0C SPIFFCT — SPI FIFO Control Register
0x0F SPIPRI — SPI Priority Control Register
