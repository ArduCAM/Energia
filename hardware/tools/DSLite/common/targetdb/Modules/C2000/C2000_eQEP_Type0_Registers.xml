# C2000_eQEP_Type0_Registers register map
Vendor: Texas Instruments
Peripheral module from a debugger description file (folder C2000).
Address unit: 16 bits
Registers are 16-bit, access not given, no defined reset value unless marked. A register's access mark holds for its fields unless they carry their own. Offsets are as the file gives them; lines under a group give offsets from that group; [hi:lo] are bit positions; {n}, {i} and the like mark numbered series; 'fields as' and 'values as' point back to an identical list; <NAME> marks a mode.

## EQEP — eQEP Control and Status Registers
0x00 QPOSCNT 32-bit — eQEP Position Counter
0x02 QPOSINIT 32-bit — eQEP Initialization Position Count
0x04 QPOSMAX 32-bit — eQEP Maximum Position Count
0x06 QPOSCMP 32-bit — eQEP Position-compare
0x08 QPOSILAT 32-bit — eQEP Index Position Latch
0x0A QPOSSLAT 32-bit — eQEP Strobe Position Latch
0x0C QPOSLAT 32-bit — eQEP Position Latch
0x0E QUTMR 32-bit — eQEP Unit Timer
0x10 QUPRD 32-bit — eQEP Unit Period Register
0x12 QWDTMR — eQEP Watchdog Timer
0x13 QWDPRD — eQEP Watchdog Period Register
0x14 QDECCTL — eQEP Decoder Control Register
0x15 QEPCTL — eQEP Control Register
0x16 QCAPCTL — eQEP Capture Control Register
0x17 QPOSCTL — eQEP Position-compare Control Register
0x18 QEINT — eQEP Interrupt Enable Register
0x19 QFLG — eQEP Interrupt Flag Register
0x1A QCLR — eQEP Interrupt Clear Register
0x1B QFRC — eQEP Interrupt Force Register
0x1C QEPSTS — eQEP Status Register
0x1D QCTMR — eQEP Capture Timer
0x1E QCPRD — eQEP Capture Period Register
0x1F QCTMRLAT — eQEP Capture Timer Latch
0x20 QCPRDLAT — eQEP Capture Period Latch
