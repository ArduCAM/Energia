# C2000_CPU_Timer_Registers register map
Vendor: Texas Instruments
Peripheral module from a debugger description file (folder C2000).
Address unit: 16 bits
Registers are 16-bit, access not given, no defined reset value unless marked. A register's access mark holds for its fields unless they carry their own. Offsets are as the file gives them; lines under a group give offsets from that group; [hi:lo] are bit positions; {n}, {i} and the like mark numbered series; 'fields as' and 'values as' point back to an identical list; <NAME> marks a mode.

## CPUTIMER — CPU Timer Registers
{0x0+8i} TIMER{i}TIM (i=0..2) — CPU-Timer {i}, Counter Register
{0x1+8i} TIMER{i}TIMH (i=0..2) — CPU-Timer {i}, Counter Register High
{0x2+8i} TIMER{i}PRD (i=0..2) — CPU-Timer {i}, Period Register
{0x3+8i} TIMER{i}PRDH (i=0..2) — CPU-Timer {i}, Period Register High
{0x4+8i} TIMER{i}TCR (i=0..2) — CPU-Timer {i}, Control Register
{0x6+8i} TIMER{i}TPR (i=0..2) — CPU-Timer {i}, Prescale Register
{0x7+8i} TIMER{i}TPRH (i=0..2) — CPU-Timer {i}, Prescale Register High
