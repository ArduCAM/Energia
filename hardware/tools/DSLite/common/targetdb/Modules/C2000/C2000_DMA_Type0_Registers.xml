# C2000_DMA_Type0_Registers register map
Vendor: Texas Instruments
Peripheral module from a debugger description file (folder C2000).
Address unit: 16 bits
Registers are 16-bit, access not given, no defined reset value unless marked. A register's access mark holds for its fields unless they carry their own. Offsets are as the file gives them; lines under a group give offsets from that group; [hi:lo] are bit positions; {n}, {i} and the like mark numbered series; 'fields as' and 'values as' point back to an identical list; <NAME> marks a mode.

## DMA — DMA Registers
0x00 DMACTRL — DMA Control Register
0x01 DEBUGCTRL — Debug Control Register
0x02 REVISION — Peripheral Revision Register
0x04 PRIORITYCTRL1 — Priority Control Register 1
0x06 PRIORITYSTAT — Priority Status Register
{0x0+0x20*i} DMACH{i}_MODE (i=1..6) — DMA Channel {i} Mode Register
{0x1+0x20*i} DMACH{i}_CONTROL (i=1..6) — DMA Channel {i} Control Register
{0x2+0x20*i} DMACH{i}_BURST_SIZE (i=1..6) — DMA Channel {i} Burst Size Register
{0x3+0x20*i} DMACH{i}_BURST_COUNT (i=1..6) — DMA Channel {i} Burst Count Register
{0x4+0x20*i} DMACH{i}_SRC_BURST_STEP (i=1..6) — DMA Channel {i} Source Burst Step Size Register
{0x5+0x20*i} DMACH{i}_DST_BURST_STEP (i=1..6) — DMA Channel {i} Destination Burst Step Size Register
{0x6+0x20*i} DMACH{i}_TRANSFER_SIZE (i=1..6) — DMA Channel {i} Transfer Size Register
{0x7+0x20*i} DMACH{i}_TRANSFER_COUNT (i=1..6) — DMA Channel {i} Transfer Count Register
{0x8+0x20*i} DMACH{i}_SRC_TRANSFER_STEP (i=1..6) — DMA Channel {i} Source Transfer Step Size Register
{0x9+0x20*i} DMACH{i}_DST_TRANSFER_STEP (i=1..6) — DMA Channel {i} Destination Transfer Step Size Register
{0xA+0x20*i} DMACH{i}_SRC_WRAP_SIZE (i=1..6) — DMA Channel {i} Source Wrap Size Register
{0xB+0x20*i} DMACH{i}_SRC_WRAP_COUNT (i=1..6) — DMA Channel {i} Source Wrap Count Register
{0xC+0x20*i} DMACH{i}_SRC_WRAP_STEP (i=1..6) — DMA Channel {i} Source Wrap Step Size Register
{0xD+0x20*i} DMACH{i}_DST_WRAP_SIZE (i=1..6) — DMA Channel {i} Destination Wrap Size Register
{0xE+0x20*i} DMACH{i}_DST_WRAP_COUNT (i=1..6) — DMA Channel {i} Destination Wrap Count Register
{0xF+0x20*i} DMACH{i}_DST_WRAP_STEP (i=1..6) — DMA Channel {i} Destination Wrap Step Size Register
{0x10+0x20*i} DMACH{i}_SRC_BEG_ADDR_SHADOW 32-bit (i=1..6) — DMA Channel {i} Shadow Source Begin Register
{0x12+0x20*i} DMACH{i}_SRC_ADDR_SHADOW 32-bit (i=1..6) — DMA Channel {i} Shadow Source Current Address Register
{0x14+0x20*i} DMACH{i}_SRC_BEG_ADDR_ACTIVE 32-bit (i=1..6) — DMA Channel {i} Active Source Begin Register
{0x16+0x20*i} DMACH{i}_SRC_ADDR_ACTIVE 32-bit (i=1..6) — DMA Channel {i} Active Source Current Address Register
{0x18+0x20*i} DMACH{i}_DST_BEG_ADDR_SHADOW 32-bit (i=1..6) — DMA Channel {i} Shadow Destination Begin Register
{0x1A+0x20*i} DMACH{i}_DST_ADDR_SHADOW 32-bit (i=1..6) — DMA Channel {i} Shadow Destination Current Address Register
{0x1C+0x20*i} DMACH{i}_DST_BEG_ADDR_ACTIVE 32-bit (i=1..6) — DMA Channel {i} Active Destination Begin Register
{0x1E+0x20*i} DMACH{i}_DST_ADDR_ACTIVE 32-bit (i=1..6) — DMA Channel {i} Active Destination Current Address Register
