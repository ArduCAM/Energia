# C2000_eCAN_Type0_Registers register map
Vendor: Texas Instruments
Peripheral module from a debugger description file (folder C2000).
Address unit: 16 bits
Registers are 32-bit, access not given, no defined reset value unless marked. A register's access mark holds for its fields unless they carry their own. Offsets are as the file gives them; lines under a group give offsets from that group; [hi:lo] are bit positions; {n}, {i} and the like mark numbered series; 'fields as' and 'values as' point back to an identical list; <NAME> marks a mode.

## ECAN — eCAN Control and Status Registers
0x00 CANME — eCAN Mailbox Enable
0x02 CANMD — eCAN Mailbox Direction
0x04 CANTRS — eCAN Transmission Request Set
0x06 CANTRR — eCAN Transmission Request Reset
0x08 CANTA — eCAN Transmission Acknowledge
0x0A CANAA — eCAN Abort Acknowledge
0x0C CANRMP — eCAN Received Message Pending
0x0E CANRML — eCAN Received Message Lost
0x10 CANRFP — eCAN Received Frame Pending
0x12 CANGAM — eCAN Global Acceptance Mask
0x14 CANMC — eCAN Master Control
0x16 CANBTC — eCAN Bit-Timing Configuration
0x18 CANES — eCAN Error and Status
0x1A CANTEC — eCAN Transmit Error Counter
0x1C CANREC — eCAN Receive Error Counter
0x1E CANGIF0 — eCAN Global Interrupt Flag 0
0x20 CANGIM — eCAN Global Interrupt Mask
0x22 CANGIF1 — eCAN Global Interrupt Flag 1
0x24 CANMIM — eCAN Mailbox Interrupt Mask
0x26 CANMIL — eCAN Mailbox Interrupt Level
0x28 CANOPC — eCAN Overwrite Protection Control
0x2A CANTIOC — eCAN TX I/O Control
0x2C CANRIOC — eCAN RX I/O Control
0x2E CANTSC — eCAN Time Stamp Counter
0x30 CANTOC — eCAN Time-Out Control
0x32 CANTOS — eCAN Time-Out Status
