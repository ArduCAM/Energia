# C2000_ADC_Type3_Registers register map
Vendor: Texas Instruments
Peripheral module from a debugger description file (folder C2000).
Address unit: 16 bits
Registers are 16-bit, access not given, no defined reset value unless marked. A register's access mark holds for its fields unless they carry their own. Offsets are as the file gives them; lines under a group give offsets from that group; [hi:lo] are bit positions; {n}, {i} and the like mark numbered series; 'fields as' and 'values as' point back to an identical list; <NAME> marks a mode.

## ADC — ADC Registers
0x00 ADCCTL1 — ADC Control 1
0x01 ADCCTL2 — ADC Control 2
0x04 ADCINTFLG — ADC Interrupt Flag
0x05 ADCINTFLGCLR — ADC Interrupt Flag Clear
0x06 ADCINTOVF — ADC Interrupt Overflow
0x07 ADCINTOVFCLR — ADC Interrupt Overflow Clear
0x08 INTSEL1N2 — ADC Interrupt 1 and 2 Selection
0x09 INTSEL3N4 — ADC Interrupt 3 and 4 Selection
0x0A INTSEL5N6 — ADC Interrupt 5 and 6 Selection
0x0B INTSEL7N8 — ADC Interrupt 7 and 8 Selection
0x0C INTSEL9N10 — ADC Interrupt 9 and 10 Selection
0x10 SOCPRICTL — ADC SOC Priority Control
0x12 ADCSAMPLEMODE — ADC Sampling Mode
0x14 ADCINTSOCSEL1 — ADC Interrupt SOC Selection 1
0x15 ADCINTSOCSEL2 — ADC Interrupt SOC Selection 2
0x18 ADCSOCFLG1 — ADC SOC Flag 1
0x1A ADCSOCFRC1 — ADC SOC Flag Force 1
0x1C ADCSOCOVF1 — ADC SOC Overflow 1
0x1E ADCSOCOVFCLR1 — ADC SOC Overflow Clear 1
{0x20+i} ADCSOC{i}CTL (i=0..15) — ADC SOC{i} Control
0x40 ADCREFTRIM — Reference Trim Register
0x41 ADCOFFTRIM — Offset Trim Register
0x4C COMPHYSTCTL — Comparator Hysteresis Control Register
