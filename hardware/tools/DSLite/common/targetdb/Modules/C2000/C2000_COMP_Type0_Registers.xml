# C2000_COMP_Type0_Registers register map
Vendor: Texas Instruments
Peripheral module from a debugger description file (folder C2000).
Address unit: 16 bits
Registers are 16-bit, access not given, no defined reset value unless marked. A register's access mark holds for its fields unless they carry their own. Offsets are as the file gives them; lines under a group give offsets from that group; [hi:lo] are bit positions; {n}, {i} and the like mark numbered series; 'fields as' and 'values as' point back to an identical list; <NAME> marks a mode.

## COMP — Comparator Registers
0x00 COMPCTL — Comparator Control Register
0x02 COMPSTS — Comparator Status Register
0x04 DACCTL — DAC Control Register
0x06 DACVAL — DAC Value Register
0x08 RAMPMAXREF_ACTIVE — Ramp Generator Maximum Reference (Active)
0x0A RAMPMAXREF_SHDW — Ramp Generator Maximum Reference (Shadow)
0x0C RAMPDECVAL_ACTIVE — Ramp Generator Decrement Value (Active)
0x0E RAMPDECVAL_SHDW — Ramp Generator Decrement Value (Shadow)
0x10 RAMPSTS — Ramp Generator Status
