# C2000_HRCAP_Type0_Registers register map
Vendor: Texas Instruments
Peripheral module from a debugger description file (folder C2000).
Address unit: 16 bits
Registers are 16-bit, access not given, no defined reset value unless marked. A register's access mark holds for its fields unless they carry their own. Offsets are as the file gives them; lines under a group give offsets from that group; [hi:lo] are bit positions; {n}, {i} and the like mark numbered series; 'fields as' and 'values as' point back to an identical list; <NAME> marks a mode.

## HRCAP1 — HRCAP1 Registers
0x00 HCCTL — HRCAP Control Register
0x01 HCIFR — HRCAP Interrupt Flag Register
0x02 HCICLR — HRCAP Interrupt Clear Register
0x03 HCIFRC — HRCAP Interrupt Force Register
0x04 HCCOUNTER — HRCAP 16-bit Counter Register
0x10 HCCAPCNTRISE0 — HRCAP Capture Counter On Rising Edge 0 Register
0x12 HCCAPCNTFALL0 — HRCAP Capture Counter On Falling Edge 0 Register
0x14 HCCAPDLYRISE0 — HRCAP Capture Delay On Rising Edge 0 Register
0x15 HCCAPDLYFALL0 — HRCAP Capture Delay On Falling Edge 0 Register
0x18 HCCAPCNTRISE1 — HRCAP Capture Counter On Rising Edge 1 Register
0x1A HCCAPCNTFALL1 — HRCAP Capture Counter On Falling Edge 1 Register
0x1C HCCAPDLYRISE1 — HRCAP Capture Delay On Rising Edge 1 Register
0x1D HCCAPDLYFALL1 — HRCAP Capture Delay On Falling Edge 1 Register
