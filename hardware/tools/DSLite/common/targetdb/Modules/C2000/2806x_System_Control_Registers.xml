# 2806x_System_Control_Registers register map
Vendor: Texas Instruments
Peripheral module from a debugger description file (folder C2000).
Address unit: 16 bits
Registers are 16-bit, access not given, no defined reset value unless marked. A register's access mark holds for its fields unless they carry their own. Offsets are as the file gives them; lines under a group give offsets from that group; [hi:lo] are bit positions; {n}, {i} and the like mark numbered series; 'fields as' and 'values as' point back to an identical list; <NAME> marks a mode.

## SYSCTRL — System Control Registers
0x00 XCLK — XCLKOUT Control
0x01 PLLSTS — PLL Status Register
0x02 CLKCTL — Clock Control Register
0x03 PLLLOCKPRD — PLL Lock Period Register
0x04 INTOSC1TRIM — Internal Oscillator 1 Trim Register
0x06 INTOSC2TRIM — Internal 32KHz Oscillator 2 Trim Register
0x09 PCLKCR2 — Peripheral Clock Control Register 2
0x0B LOSPCP — Low-Speed Peripheral Clock Pre-Scaler Register
0x0C PCLKCR0 — Peripheral Clock Control Register 0
0x0D PCLKCR1 — Peripheral Clock Control Register 1
0x0E LPMCR0 — Low Power Mode Control Register 0
0x10 PCLKCR3 — Peripheral Clock Control Register 3
0x11 PLLCR — PLL Control Register
0x12 SCSR — System Control and Status Register
0x13 WDCNTR — Watchdog Counter Register
0x15 WDKEY — Watchdog Reset Key Register
0x19 WDCR — Watchdog Control Register
0x1A JTAGDEBUG — JTAG Port Debug Register
0x20 PLL2CTL — PLL2 Configuration Register
0x22 PLL2MULT — PLL2 Multiplier Register
0x24 PLL2STS — PLL2 Lock Status Register
0x26 SYSCLK2CNTR — Sys Clock 2 Counter Register
0x2A EPWMCFG — EPWM DMA/CLA Configuration Register
