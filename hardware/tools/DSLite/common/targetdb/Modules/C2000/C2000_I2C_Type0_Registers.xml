# C2000_I2C_Type0_Registers register map
Vendor: Texas Instruments
Peripheral module from a debugger description file (folder C2000).
Address unit: 16 bits
Registers are 16-bit, access not given, no defined reset value unless marked. A register's access mark holds for its fields unless they carry their own. Offsets are as the file gives them; lines under a group give offsets from that group; [hi:lo] are bit positions; {n}, {i} and the like mark numbered series; 'fields as' and 'values as' point back to an identical list; <NAME> marks a mode.

## I2C — I2C Registers
0x00 I2COAR — I2C own address register
0x01 I2CIER — I2C interrupt enable register
0x02 I2CSTR — I2C status register
0x03 I2CCLKL — I2C clock low-time divider register
0x04 I2CCLKH — I2C clock high-time divider register
0x05 I2CCNT — I2C data count register
0x06 I2CDRR — I2C data receive register
0x07 I2CSAR — I2C slave address register
0x08 I2CDXR — I2C data transmit register
0x09 I2CMDR — I2C mode register
0x0A I2CISRC — I2C interrupt source register
0x0C I2CPSC — I2C prescaler register
0x20 I2CFFTX — I2C FIFO transmit register
0x21 I2CFFRX — I2C FIFO receive register
