# PC_356.0 register map
Vendor: Texas Instruments
Peripheral module from a debugger description file (folder MSP432).
Registers are 16-bit, access not given, no defined reset value unless marked. A register's access mark holds for its fields unless they carry their own. Offsets are as the file gives them; lines under a group give offsets from that group; [hi:lo] are bit positions; {n}, {i} and the like mark numbered series; 'fields as' and 'values as' point back to an identical list; <NAME> marks a mode.

## PC
0x40 PCIN — Port C Input
0x42 PCOUT — Port C Output
0x44 PCDIR — Port C Direction
0x46 PCREN — Port C Resistor Enable
0x48 PCDS — Port C Drive Strength
0x4A PCSEL0 — Port C Select 0
0x4C PCSEL1 — Port C Select 1
0x56 PCSELC — Port C Complement Select
0x58 PCIES — Port C Interrupt Edge Select
0x5A PCIE — Port C Interrupt Enable
0x5C PCIFG — Port C Interrupt Flag
