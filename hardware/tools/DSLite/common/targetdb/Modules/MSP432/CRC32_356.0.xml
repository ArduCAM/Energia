# CRC32_356.0 register map
Vendor: Texas Instruments
Peripheral module from a debugger description file (folder MSP432).
Registers are 16-bit, access not given, no defined reset value unless marked. A register's access mark holds for its fields unless they carry their own. Offsets are as the file gives them; lines under a group give offsets from that group; [hi:lo] are bit positions; {n}, {i} and the like mark numbered series; 'fields as' and 'values as' point back to an identical list; <NAME> marks a mode.

## CRC32
0x00 CRC32DI — Data Input for CRC32 Signature Computation
0x04 CRC32DIRB — Data In Reverse for CRC32 Computation
0x08 CRC32INIRES_LO — CRC32 Initialization and Result, lower 16 bits
0x0A CRC32INIRES_HI — CRC32 Initialization and Result, upper 16 bits
0x0C CRC32RESR_LO — CRC32 Result Reverse, lower 16 bits
0x0E CRC32RESR_HI — CRC32 Result Reverse, Upper 16 bits
0x10 CRC16DI — Data Input for CRC16 computation
0x14 CRC16DIRB — CRC16 Data In Reverse
0x18 CRC16INIRES — CRC16 Initialization and Result register
0x1E CRC16RESR — CRC16 Result Reverse
