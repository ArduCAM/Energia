# PJ_356.0 register map
Vendor: Texas Instruments
Peripheral module from a debugger description file (folder MSP432).
Registers are 16-bit, access not given, no defined reset value unless marked. A register's access mark holds for its fields unless they carry their own. Offsets are as the file gives them; lines under a group give offsets from that group; [hi:lo] are bit positions; {n}, {i} and the like mark numbered series; 'fields as' and 'values as' point back to an identical list; <NAME> marks a mode.

## PJ
0x120 PJIN — Port J Input
0x122 PJOUT — Port J Output
0x124 PJDIR — Port J Direction
0x126 PJREN — Port J Resistor Enable
0x128 PJDS — Port J Drive Strength
0x12A PJSEL0 — Port J Select 0
0x12C PJSEL1 — Port J Select 1
0x136 PJSELC — Port J Complement Select
