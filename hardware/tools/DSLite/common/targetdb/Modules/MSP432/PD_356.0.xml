# PD_356.0 register map
Vendor: Texas Instruments
Peripheral module from a debugger description file (folder MSP432).
Registers are 16-bit, access not given, no defined reset value unless marked. A register's access mark holds for its fields unless they carry their own. Offsets are as the file gives them; lines under a group give offsets from that group; [hi:lo] are bit positions; {n}, {i} and the like mark numbered series; 'fields as' and 'values as' point back to an identical list; <NAME> marks a mode.

## PD
0x60 PDIN — Port D Input
0x62 PDOUT — Port D Output
0x64 PDDIR — Port D Direction
0x66 PDREN — Port D Resistor Enable
0x68 PDDS — Port D Drive Strength
0x6A PDSEL0 — Port D Select 0
0x6C PDSEL1 — Port D Select 1
0x76 PDSELC — Port D Complement Select
0x78 PDIES — Port D Interrupt Edge Select
0x7A PDIE — Port D Interrupt Enable
0x7C PDIFG — Port D Interrupt Flag
