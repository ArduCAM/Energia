# AUX_SMPH register map
Vendor: Texas Instruments
Peripheral module from a debugger description file (folder CC2650).
Registers are 32-bit, access per field, reset 0x1 unless marked. A register's access mark holds for its fields unless they carry their own. Offsets are as the file gives them; lines under a group give offsets from that group; [hi:lo] are bit positions; {n}, {i} and the like mark numbered series; 'fields as' and 'values as' point back to an identical list; <NAME> marks a mode.

## AUX_SMPH — AUX Semaphore Controller
{0x0+4i} SMPH{i} (i=0..7) — Semaphore {i}
  [0] STAT rw — Status when reading: 0: Semaphore was already taken 1: Semaphore was available and hence taken by this read access Reading the register causes it to change value to 0. Releasing the semaphore is done by writing 1
0x20 AUTOTAKE reset 0x0 — Sticky Request For Single Semaphore
  [2:0] SMPH_ID rw — Requesting a certain semaphore is done by writing the corresponding semaphore ID, 0x0-0x7, to SMPH_ID. The request is sticky and once the semaphore becomes available it will be taken. At the same time, SMPH_AUTOTAKE_DONE event is asserted. This event is deasserted when SW releases the semaphore or a new ID is written to SMPH_ID. Note: SW must wait until SMPH_AUTOTAKE_DONE event is triggered before writing a new ID to SMPH_ID . Failing to do so might lead to permanently lost semaphores as the owners may be unknown
